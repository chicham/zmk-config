## boards/shields/rgb_layer_color/Kconfig.defconfig
```kconfig
# Copyright (c) 2020 The ZMK Contributors
# SPDX-License-Identifier: MIT

if SHIELD_RGB_LAYER_COLOR

config ZMK_RGB_UNDERGLOW
    default y

endif # SHIELD_RGB_LAYER_COLOR
```

## boards/shields/rgb_layer_color/Kconfig.shield
```kconfig
# Copyright (c) 2020 The ZMK Contributors
# SPDX-License-Identifier: MIT

config SHIELD_RGB_LAYER_COLOR
    def_bool $(shields_list_contains,rgb_layer_color)
```
